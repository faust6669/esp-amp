## examples/build_system/separate_build/subcore_project/sdkconfig.defaults
```kconfig
# Enable ESP_AMP
CONFIG_ESP_AMP_ENABLED=y
CONFIG_ESPTOOLPY_FLASHSIZE_4MB=y

# Route Subcore Print to Maincore Console
CONFIG_ESP_AMP_SYSTEM_ENABLE_SUPPLICANT=y
CONFIG_ESP_AMP_ROUTE_SUBCORE_PRINT=y
```

## examples/build_system/unified_build/sdkconfig.defaults
```kconfig
# Enable ESP_AMP
CONFIG_ESP_AMP_ENABLED=y
CONFIG_ESPTOOLPY_FLASHSIZE_4MB=y

# Partition Table
CONFIG_PARTITION_TABLE_CUSTOM=y
CONFIG_PARTITION_TABLE_CUSTOM_FILENAME="partitions.csv"
CONFIG_PARTITION_TABLE_FILENAME="partitions.csv"

# Subcore Kconfig
CONFIG_SUBCORE_GREETING_MESSAGE="SUB: Hello from subcore (custom)"
CONFIG_SUBCORE_MAIN_DELAY_MS=2000

# Route Subcore Print to Maincore Console
CONFIG_ESP_AMP_SYSTEM_ENABLE_SUPPLICANT=y
CONFIG_ESP_AMP_ROUTE_SUBCORE_PRINT=y
```

## examples/build_system/unified_build/subcore/components/sub_greeting/Kconfig
```kconfig
menu "Subcore Example Greeting Configuration"

    config SUBCORE_GREETING_MESSAGE
        string "Subcore greeting message"
        default "SUB: Hello from subcore (default)"

endmenu
```

## examples/software_interrupt/sdkconfig.defaults
```kconfig
# Enable ESP_AMP
CONFIG_ESP_AMP_ENABLED=y
CONFIG_ESPTOOLPY_FLASHSIZE_4MB=y

# Partition Table
CONFIG_PARTITION_TABLE_CUSTOM=y
CONFIG_PARTITION_TABLE_CUSTOM_FILENAME="partitions.csv"
CONFIG_PARTITION_TABLE_FILENAME="partitions.csv"

# Increase Software Interrupt Handler Table Size
CONFIG_ESP_AMP_SW_INTR_HANDLER_TABLE_LEN=12

# Route Subcore Print to Maincore Console
CONFIG_ESP_AMP_SYSTEM_ENABLE_SUPPLICANT=y
CONFIG_ESP_AMP_ROUTE_SUBCORE_PRINT=y
```
